// ZMK Core Includes
#include <behaviors.dtsi>
// #include <behaviors/num_word.dtsi> // requires https://github.com/urob/zmk-auto-layer module
#include <dt-bindings/zmk/keys.h>
#include <dt-bindings/zmk/bt.h>
#include <dt-bindings/zmk/outputs.h>

// Layers
#define L0 0  // Base/QWERTY
#define SY 1  // Symbols/Numbers
#define UT 2  // Utilities/Keyboard Functions
#define NAV 3 // Navigation/Function Keys

// Meh key
#define MEH LS(LC(LALT))
// Hyper key (Ctrl+Shift+Alt+Cmd)
#define HYPR LS(LC(LA(LGUI)))

// Custom keycodes for tmux
#define TMUX_PRE LC(A)    // Ctrl+A (tmux prefix)

// Linux/Hyprland shortcuts (Super key based)
#define HYPR_TERM LG(ENTER)     // Terminal
#define HYPR_DMENU LG(D)        // Application launcher
#define HYPR_CLOSE LG(Q)        // Close window
#define HYPR_FULL LG(F)         // Toggle fullscreen
#define HYPR_FLOAT LG(SPACE)    // Toggle floating

// Behaviors Constants
#define TAPPING_TERM_MS 280
#define QUICK_TAP_MS 175
#define REQUIRE_PRIOR_IDLE_MS 150

// Key positions per hand
#define KEYS_L 0 1 2 3 4 5 12 13 14 15 16 17 24 25 26 27 28 29
#define KEYS_R 6 7 8 9 10 11 18 19 20 21 22 23 30 31 32 33 34 35
#define THUMBS 36 37 38 39 40 41

#include "behaviors.dtsi"
#include "macros.dtsi"

// Base layer
#include "L0_qwerty.dtsi"

// Symbols layer
#include "L1_symbols.dtsi"

// Utilities layer
#include "L2_utilities.dtsi"

// Navigation layer
#include "L3_navigation.dtsi"




